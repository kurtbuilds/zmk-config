## app/boards/shields/wkb64/Kconfig.defconfig
```kconfig
if SHIELD_WKB64_LEFT

config ZMK_KEYBOARD_NAME
    default "wkb64 Left"

config ZMK_SPLIT
    default y

config ZMK_SPLIT_BLE_ROLE_CENTRAL
    default y

endif

if SHIELD_WKB64_RIGHT

config ZMK_KEYBOARD_NAME
    default "wkb64 Right"

config ZMK_SPLIT
    default y

endif
```

## app/boards/shields/wkb64/Kconfig.shield
```kconfig
config SHIELD_WKB64_LEFT
    def_bool $(shields_list_contains,wkb64_left)

config SHIELD_WKB64_RIGHT
    def_bool $(shields_list_contains,wkb64_right)
```
